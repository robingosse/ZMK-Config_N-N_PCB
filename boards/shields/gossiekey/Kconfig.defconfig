## boards/shields/gossiekey/Kconfig.defconfig
```kconfig
if SHIELD_GOSSIEKEY_LEFT || SHIELD_GOSSIEKEY_RIGHT

config ZMK_KEYBOARD_NAME
    default "GossieKey"

config ZMK_SPLIT
    default y

if SHIELD_GOSSIEKEY_LEFT

config ZMK_SPLIT_ROLE_CENTRAL
    default y

endif # SHIELD_GOSSIEKEY_LEFT

endif # SHIELD_GOSSIEKEY_LEFT || SHIELD_GOSSIEKEY_RIGHT
```

## config/boards/shields/gossiekey/Kconfig.shield
```kconfig
config SHIELD_GOSSIEKEY_LEFT
    def_bool $(shields_list_contains,gossiekey_left)

config SHIELD_GOSSIEKEY_RIGHT
    def_bool $(shields_list_contains,gossiekey_right)
```
