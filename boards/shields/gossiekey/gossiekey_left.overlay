#include "gossiekey.dtsi"

&default_transform {
    col-offset = <0>;
};

&kscan0 {
    compatible = "zmk,kscan-gpio-matrix";
    wakeup-source;
    diode-direction = "col2row";

    row-gpios
        = <&gpio1  6 GPIO_ACTIVE_HIGH>   // R0 = 106
        , <&gpio1  4 GPIO_ACTIVE_HIGH>   // R1 = 104
        , <&gpio0 11 GPIO_ACTIVE_HIGH>   // R2 = 011
        ;

    col-gpios
        = <&gpio0  6 (GPIO_ACTIVE_HIGH | GPIO_PULL_DOWN)>   // C0 = 006
        , <&gpio0 10 (GPIO_ACTIVE_HIGH | GPIO_PULL_DOWN)>   // C1 = 010
        , <&gpio1 11 (GPIO_ACTIVE_HIGH | GPIO_PULL_DOWN)>   // C2 = 111
        , <&gpio1 13 (GPIO_ACTIVE_HIGH | GPIO_PULL_DOWN)>   // C3 = 113
        , <&gpio1 15 (GPIO_ACTIVE_HIGH | GPIO_PULL_DOWN)>   // C4 = 115
        , <&gpio0  2 (GPIO_ACTIVE_HIGH | GPIO_PULL_DOWN)>   // C5 = 002
        ;
};
